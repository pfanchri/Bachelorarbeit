# XMC4200 register map
Vendor: Infineon; File version: 1.5.2 (Reference Manual v1.5)
SVD file
CPU: CM4 r2p0, little endian, MPU, FPU, 6 interrupt priority bits
Registers are 32-bit, read-write, reset 0x0 unless marked. A register's access mark holds for its fields unless they carry their own. Offsets are from the block's base; lines under a group give offsets from that group; [hi:lo] are bit positions; {n}, {i} and the like mark numbered series; 'fields as' and 'values as' point back to an identical list; <NAME> marks a mode.

## Memory map
0x40000000 PBA0 size 0x4000 — Peripheral Bridge AHB 0
0x40004000 VADC size 0x400 — Analog to Digital Converter
0x40004400 VADC_G0 size 0x400 — Analog to Digital Converter
0x40004800 VADC_G1 size 0x400 — Analog to Digital Converter
0x4000C000 CCU40 size 0x100 — Capture Compare Unit 4 - Unit 0
0x4000C100 CCU40_CC40 size 0x100 — Capture Compare Unit 4 - Unit 0
0x4000C200 CCU40_CC41 size 0x100 — Capture Compare Unit 4 - Unit 0
0x4000C300 CCU40_CC42 size 0x100 — Capture Compare Unit 4 - Unit 0
0x4000C400 CCU40_CC43 size 0x100 — Capture Compare Unit 4 - Unit 0
0x40010000 CCU41 size 0x100 — Capture Compare Unit 4 - Unit 1
0x40010100 CCU41_CC40 size 0x100 — Capture Compare Unit 4 - Unit 1
0x40010200 CCU41_CC41 size 0x100 — Capture Compare Unit 4 - Unit 1
0x40010300 CCU41_CC42 size 0x100 — Capture Compare Unit 4 - Unit 1
0x40010400 CCU41_CC43 size 0x100 — Capture Compare Unit 4 - Unit 1
0x40020000 CCU80 size 0x100 — Capture Compare Unit 8 - Unit 0
0x40020100 CCU80_CC80 size 0x100 — Capture Compare Unit 8 - Unit 0
0x40020200 CCU80_CC81 size 0x100 — Capture Compare Unit 8 - Unit 0
0x40020300 CCU80_CC82 size 0x100 — Capture Compare Unit 8 - Unit 0
0x40020400 CCU80_CC83 size 0x100 — Capture Compare Unit 8 - Unit 0
0x40020900 HRPWM0 size 0x100 — High Resolution PWM Unit
0x40020A00 HRPWM0_CSG0 size 0x100 — High Resolution PWM Unit
0x40020B00 HRPWM0_CSG1 size 0x100 — High Resolution PWM Unit
0x40020C00 HRPWM0_CSG2 size 0x100 — High Resolution PWM Unit
0x40021300 HRPWM0_HRC0 size 0x100 — High Resolution PWM Unit
0x40021400 HRPWM0_HRC1 size 0x100 — High Resolution PWM Unit
0x40021500 HRPWM0_HRC2 size 0x100 — High Resolution PWM Unit
0x40021600 HRPWM0_HRC3 size 0x100 — High Resolution PWM Unit
0x40028000 POSIF0 size 0x4000 — Position Interface 0
0x40030000 USIC0_CH0 size 0x200 — Universal Serial Interface Controller 0
0x40030008 USIC0 size 0x4 — Universal Serial Interface Controller 0
0x40030200 USIC0_CH1 size 0x200 — Universal Serial Interface Controller 0
0x40044000 ERU1 size 0x4000 — Event Request Unit 1
0x48000000 PBA1 size 0x4000 — Peripheral Bridge AHB 1
0x48010000 LEDTS0 size 0x100 — LED and Touch Sense Unit 0
0x48014000 CAN size 0x200 — Controller Area Networks
0x48014200 CAN_NODE0 size 0x100 — Controller Area Networks
0x48014300 CAN_NODE1 size 0x100 — Controller Area Networks
{0x48015000+0x20*n} CAN_MO{n} size 0x20 (n=0..63) — Controller Area Networks
0x48018000 DAC size 0x4000 — Digital to Analog Converter
0x48020000 USIC1_CH0 size 0x200 — Universal Serial Interface Controller 1
0x48020008 USIC1 size 0x4 — Universal Serial Interface Controller 1
0x48020200 USIC1_CH1 size 0x200 — Universal Serial Interface Controller 1
0x48028000 PORT0 size 0x100
0x48028100 PORT1 size 0x100
0x48028200 PORT2 size 0x100
0x48028300 PORT3 size 0x100
0x48028E00 PORT14 size 0x100
0x50004000 SCU_GENERAL size 0x100 — System Control Unit
0x50004074 SCU_INTERRUPT size 0x18 — System Control Unit
0x5000413C SCU_PARITY size 0x20 — System Control Unit
0x50004160 SCU_TRAP size 0x14 — System Control Unit
0x50004200 SCU_POWER size 0x100 — System Control Unit
0x50004300 SCU_HIBERNATE size 0x100 — System Control Unit
0x50004400 SCU_RESET size 0x100 — System Control Unit
0x50004600 SCU_CLK size 0x100 — System Control Unit
0x50004700 SCU_OSC size 0x10 — System Control Unit
0x50004710 SCU_PLL size 0x2C — System Control Unit
0x50004800 ERU0 size 0x100 — Event Request Unit 0
0x50004900 DLR size 0x100 — DMA Line Router
0x50004A00 RTC size 0x200 — Real Time Clock
0x50008000 WDT size 0x4000 — Watch Dog Timer
{0x50014000+0x58*n} GPDMA0_CH{n} size 0x55 (n=0..7) — General Purpose DMA Unit 0
0x500142C0 GPDMA0 size 0x3D40 — General Purpose DMA Unit 0
0x50020000 FCE size 0x20 — Flexible CRC Engine
0x50020020 FCE_KE0 size 0x20 — Flexible CRC Engine
0x50020040 FCE_KE1 size 0x20 — Flexible CRC Engine
0x50020060 FCE_KE2 size 0x20 — Flexible CRC Engine
0x50020080 FCE_KE3 size 0x20 — Flexible CRC Engine
0x50040000 USB0 size 0x40000 — Universal Serial Bus
0x50040900 USB0_EP0 size 0x400 — Universal Serial Bus
0x50040920 USB0_EP1 size 0x400 — Universal Serial Bus
0x50040940 USB0_EP2 size 0x400 — Universal Serial Bus
0x50040960 USB0_EP3 size 0x400 — Universal Serial Bus
0x50040980 USB0_EP4 size 0x400 — Universal Serial Bus
0x500409A0 USB0_EP5 size 0x400 — Universal Serial Bus
0x500409C0 USB0_EP6 size 0x400 — Universal Serial Bus
0x58000508 PMU0 size 0x4 — Program Management Unit
0x58001000 FLASH0 size 0x1400 — Flash Memory Controller
0x58004000 PREF size 0x4 — Prefetch Unit
0xE000E000 PPB size 0x1000 — Cortex-M4 Private Peripheral Block

## Interrupts
0 SCU_0 (SCU_INTERRUPT) — System Control
1 ERU0_0 (ERU0) — External Request Unit 0
2 ERU0_1 (ERU0) — External Request Unit 0
3 ERU0_2 (ERU0) — External Request Unit 0
4 ERU0_3 (ERU0) — External Request Unit 0
5 ERU1_0 (ERU1) — External Request Unit 1
6 ERU1_1 (ERU1) — External Request Unit 1
7 ERU1_2 (ERU1) — External Request Unit 1
8 ERU1_3 (ERU1) — External Request Unit 1
12 PMU0_0 (PMU0) — Program Management Unit
14 VADC0_C0_0 (VADC) — Analog to Digital Converter Common Block 0
15 VADC0_C0_1 (VADC) — Analog to Digital Converter Common Block 0
16 VADC0_C0_2 (VADC) — Analog to Digital Converter Common Block 0
17 VADC0_C0_3 (VADC) — Analog to Digital Converter Common Block 0
18 VADC0_G0_0 (VADC_G0) — Analog to Digital Converter Group 0
19 VADC0_G0_1 (VADC_G0) — Analog to Digital Converter Group 0
20 VADC0_G0_2 (VADC_G0) — Analog to Digital Converter Group 0
21 VADC0_G0_3 (VADC_G0) — Analog to Digital Converter Group 0
22 VADC0_G1_0 (VADC_G1) — Analog to Digital Converter Group 1
23 VADC0_G1_1 (VADC_G1) — Analog to Digital Converter Group 1
24 VADC0_G1_2 (VADC_G1) — Analog to Digital Converter Group 1
25 VADC0_G1_3 (VADC_G1) — Analog to Digital Converter Group 1
42 DAC0_0 (DAC) — Digital to Analog Converter
43 DAC0_1 (DAC) — Digital to Analog Converter
44 CCU40_0 (CCU40) — Capture Compare Unit 4 (Module 0)
45 CCU40_1 (CCU40) — Capture Compare Unit 4 (Module 0)
46 CCU40_2 (CCU40) — Capture Compare Unit 4 (Module 0)
47 CCU40_3 (CCU40) — Capture Compare Unit 4 (Module 0)
48 CCU41_0 (CCU41) — Capture Compare Unit 4 (Module 1)
49 CCU41_1 (CCU41) — Capture Compare Unit 4 (Module 1)
50 CCU41_2 (CCU41) — Capture Compare Unit 4 (Module 1)
51 CCU41_3 (CCU41) — Capture Compare Unit 4 (Module 1)
60 CCU80_0 (CCU80) — Capture Compare Unit 8 (Module 0)
61 CCU80_1 (CCU80) — Capture Compare Unit 8 (Module 0)
62 CCU80_2 (CCU80) — Capture Compare Unit 8 (Module 0)
63 CCU80_3 (CCU80) — Capture Compare Unit 8 (Module 0)
68 POSIF0_0 (POSIF0) — Position Interface (Module 0)
69 POSIF0_1 (POSIF0) — Position Interface (Module 0)
72 HRPWM_0 (HRPWM0) — High Resolution Pulse Width Modulation (Module 0)
73 HRPWM_1 (HRPWM0) — High Resolution Pulse Width Modulation (Module 0)
74 HRPWM_2 (HRPWM0) — High Resolution Pulse Width Modulation (Module 0)
75 HRPWM_3 (HRPWM0) — High Resolution Pulse Width Modulation (Module 0)
{n+76} CAN0_{n} (CAN) (n=0..7) — MultiCAN
84 USIC0_0 (USIC0) — Universal Serial Interface Channel (Module 0)
85 USIC0_1 (USIC0) — Universal Serial Interface Channel (Module 0)
86 USIC0_2 (USIC0) — Universal Serial Interface Channel (Module 0)
87 USIC0_3 (USIC0) — Universal Serial Interface Channel (Module 0)
88 USIC0_4 (USIC0) — Universal Serial Interface Channel (Module 0)
89 USIC0_5 (USIC0) — Universal Serial Interface Channel (Module 0)
90 USIC1_0 (USIC1) — Universal Serial Interface Channel (Module 1)
91 USIC1_1 (USIC1) — Universal Serial Interface Channel (Module 1)
92 USIC1_2 (USIC1) — Universal Serial Interface Channel (Module 1)
93 USIC1_3 (USIC1) — Universal Serial Interface Channel (Module 1)
94 USIC1_4 (USIC1) — Universal Serial Interface Channel (Module 1)
95 USIC1_5 (USIC1) — Universal Serial Interface Channel (Module 1)
102 LEDTS0_0 (LEDTS0) — LED and Touch Sense Control Unit (Module 0)
104 FCE0_0 (FCE) — Flexible CRC Engine
105 GPDMA0_0 (GPDMA0) — General Purpose DMA Unit 0
107 USB0_0 (USB0_EP1) — Universal Serial Bus (Module 0)
108 ETH0_0 (USB0_EP0) — Ethernet (Module 0)

## Notices in the file
Copyright (C) 2016 Infineon Technologies AG. All rights reserved.
Infineon Technologies AG (Infineon) is supplying this software for use with
Infineon's microcontrollers.  This file can be freely distributed within
development tools that are supporting such microcontrollers.
THIS SOFTWARE IS PROVIDED "AS IS".  NO WARRANTIES, WHETHER EXPRESS, IMPLIED
OR STATUTORY, INCLUDING, BUT NOT LIMITED TO, IMPLIED WARRANTIES OF
MERCHANTABILITY AND FITNESS FOR A PARTICULAR PURPOSE APPLY TO THIS SOFTWARE.
INFINEON SHALL NOT, IN ANY CIRCUMSTANCES, BE LIABLE FOR SPECIAL, INCIDENTAL,
OR CONSEQUENTIAL DAMAGES, FOR ANY REASON WHATSOEVER.
